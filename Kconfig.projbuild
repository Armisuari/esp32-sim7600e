## Kconfig.projbuild
```kconfig
menu "SIM7600E Configuration"

    config SIM7600E_UART_PORT_NUM
        int "UART port number"
        range 0 2
        default 2
        help
            UART port number for SIM7600E communication.

    config SIM7600E_TX_GPIO
        int "UART TX GPIO number"
        range 0 48
        default 2
        help
            GPIO number for UART TX pin.

    config SIM7600E_RX_GPIO
        int "UART RX GPIO number"
        range 0 48
        default 1
        help
            GPIO number for UART RX pin.

    config SIM7600E_PWRKEY_GPIO
        int "Power Key GPIO number"
        range 0 48
        default 41
        help
            GPIO number for SIM7600E power key control.

    config SIM7600E_UART_BAUD_RATE
        int "UART baud rate"
        default 115200
        help
            UART baud rate for SIM7600E communication.

    config SIM7600E_UART_BUF_SIZE
        int "UART buffer size"
        range 512 4096
        default 1024
        help
            UART RX/TX buffer size in bytes.

    menu "Queue Configuration"
        
        config SIM7600E_URC_QUEUE_SIZE
            int "URC queue size"
            range 5 50
            default 10
            help
                Size of the queue for Unsolicited Result Codes.

        config SIM7600E_RESP_QUEUE_SIZE
            int "Response queue size"
            range 3 20
            default 5
            help
                Size of the queue for AT command responses.

        config SIM7600E_GNSS_QUEUE_SIZE
            int "GNSS queue size"
            range 1 10
            default 1
            help
                Size of the queue for GNSS data.

    endmenu

    menu "GNSS Configuration"

        config SIM7600E_GNSS_DEFAULT_UPDATE_RATE
            int "Default GNSS update rate (ms)"
            range 100 60000
            default 1000
            help
                Default update rate for GNSS position updates in milliseconds.

        config SIM7600E_GNSS_ENABLE_GPS
            bool "Enable GPS constellation"
            default y
            help
                Enable GPS constellation for positioning.

        config SIM7600E_GNSS_ENABLE_GLONASS
            bool "Enable GLONASS constellation"
            default y
            help
                Enable GLONASS constellation for positioning.

        config SIM7600E_GNSS_ENABLE_GALILEO
            bool "Enable Galileo constellation"
            default n
            help
                Enable Galileo constellation for positioning.

        config SIM7600E_GNSS_ENABLE_BEIDOU
            bool "Enable BeiDou constellation"
            default n
            help
                Enable BeiDou constellation for positioning.

    endmenu

    menu "TCP Configuration"

        config SIM7600E_TCP_DEFAULT_TIMEOUT
            int "Default TCP timeout (ms)"
            range 5000 120000
            default 30000
            help
                Default timeout for TCP operations in milliseconds.

        config SIM7600E_TCP_KEEPALIVE_ENABLE
            bool "Enable TCP Keep-alive by default"
            default n
            help
                Enable TCP keep-alive by default for new connections.

        config SIM7600E_TCP_KEEPALIVE_IDLE
            int "TCP Keep-alive idle time (seconds)"
            range 60 86400
            default 7200
            depends on SIM7600E_TCP_KEEPALIVE_ENABLE
            help
                TCP keep-alive idle time in seconds.

        config SIM7600E_TCP_KEEPALIVE_INTERVAL
            int "TCP Keep-alive probe interval (seconds)"
            range 1 3600
            default 30
            depends on SIM7600E_TCP_KEEPALIVE_ENABLE
            help
                TCP keep-alive probe interval in seconds.

        config SIM7600E_TCP_KEEPALIVE_COUNT
            int "TCP Keep-alive probe count"
            range 1 20
            default 9
            depends on SIM7600E_TCP_KEEPALIVE_ENABLE
            help
                Number of TCP keep-alive probes.

    endmenu

    menu "Logging"

        config SIM7600E_LOG_LEVEL
            int "SIM7600E log level"
            range 0 5
            default 3
            help
                Log level for SIM7600E component:
                0: No output
                1: Error
                2: Warning  
                3: Info
                4: Debug
                5: Verbose

    endmenu

endmenu
```

## examples/basic_mqtt/sdkconfig.defaults
```kconfig
# ESP32-S3 Configuration
CONFIG_IDF_TARGET_ESP32S3=y

# UART Configuration
CONFIG_ESP_CONSOLE_UART_NUM_1=y
CONFIG_ESP_CONSOLE_UART_TX_GPIO=2
CONFIG_ESP_CONSOLE_UART_RX_GPIO=1

# Increase main task stack size for MQTT operations
CONFIG_ESP_MAIN_TASK_STACK_SIZE=16384

# Memory Management
CONFIG_ESP_SYSTEM_EVENT_QUEUE_SIZE=32
CONFIG_ESP_SYSTEM_EVENT_TASK_STACK_SIZE=4096

# Task Watchdog
CONFIG_ESP_TASK_WDT_TIMEOUT_S=60
CONFIG_ESP_TASK_WDT_CHECK_IDLE_TASK_CPU0=y
CONFIG_ESP_TASK_WDT_CHECK_IDLE_TASK_CPU1=y

# FreeRTOS Configuration
CONFIG_FREERTOS_HZ=1000
CONFIG_FREERTOS_USE_TRACE_FACILITY=y
CONFIG_FREERTOS_USE_STATS_FORMATTING_FUNCTIONS=y

# UART/Communication
CONFIG_UART_ISR_IN_IRAM=y

# MQTT Configuration (these aren't used in our simple implementation but good to have)
CONFIG_MQTT_PROTOCOL_311=y
CONFIG_MQTT_TRANSPORT_SSL=y
CONFIG_MQTT_TRANSPORT_WEBSOCKET=y

# Network configuration
CONFIG_LWIP_SO_REUSE=y
CONFIG_LWIP_SO_REUSE_RXTOALL=y
CONFIG_LWIP_MAX_SOCKETS=16

# Log level
CONFIG_LOG_DEFAULT_LEVEL_INFO=y
CONFIG_LOG_MAXIMUM_LEVEL_VERBOSE=y

# Bootloader
CONFIG_BOOTLOADER_LOG_LEVEL_WARN=y

# Compiler optimizations
CONFIG_COMPILER_OPTIMIZATION_DEFAULT=y
CONFIG_COMPILER_STACK_CHECK_MODE_STRONG=y
```

## examples/mqtt_tls/sdkconfig.defaults
```kconfig
# ESP-IDF Configuration for MQTT TLS
# TLS/SSL Configuration
CONFIG_MBEDTLS_CERTIFICATE_BUNDLE=y
CONFIG_MBEDTLS_CERTIFICATE_BUNDLE_DEFAULT_FULL=y
CONFIG_MBEDTLS_SSL_PROTO_TLS1_2=y
CONFIG_MBEDTLS_SSL_ALPN=y
CONFIG_MBEDTLS_SSL_SESSION_TICKETS=y

# Increase SSL buffer sizes for TLS
CONFIG_MBEDTLS_SSL_IN_CONTENT_LEN=8192
CONFIG_MBEDTLS_SSL_OUT_CONTENT_LEN=4096

# TCP/IP Configuration  
CONFIG_LWIP_TCP_SND_BUF_DEFAULT=8192
CONFIG_LWIP_TCP_WND_DEFAULT=8192
CONFIG_LWIP_TCP_MSS=1436
CONFIG_LWIP_TCP_RECVMBOX_SIZE=8

# Logging Configuration
CONFIG_LOG_DEFAULT_LEVEL_INFO=y
CONFIG_LOG_DEFAULT_LEVEL=3

# MQTT Configuration
CONFIG_MQTT_PROTOCOL_311=y
CONFIG_MQTT_TRANSPORT_SSL=y
CONFIG_MQTT_TRANSPORT_WEBSOCKET=y
CONFIG_MQTT_TRANSPORT_WEBSOCKET_SECURE=y

# ESP32-S3 Optimizations
CONFIG_FREERTOS_HZ=1000
CONFIG_ESP_SYSTEM_EVENT_QUEUE_SIZE=32
CONFIG_ESP_MAIN_TASK_STACK_SIZE=8192

# Memory Configuration
CONFIG_ESP_DEFAULT_CPU_FREQ_MHZ_240=y
CONFIG_ESP_DEFAULT_CPU_FREQ_MHZ=240
```
